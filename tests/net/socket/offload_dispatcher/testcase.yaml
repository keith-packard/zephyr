## tests/net/socket/offload_dispatcher/testcase.yaml
```yaml
common:
  depends_on: netif
tests:
  net.socket.offload.dispatcher:
    tags: net socket
    extra_configs:
      - CONFIG_ZTEST_STACK_SIZE=8192
```
